## drivers/mfx_v3/Kconfig
```kconfig
menuconfig MFX
    bool "MFX"
    help
    include MFX driver.

if MFX

module = MFX
module-str = MFX
source "subsys/logging/Kconfig.template.log_config"

config MFX_INIT_PRIORITY
    int "MFX init priority"
    default 90
    help
        Set the priority of the MFX driver. 


source "drivers/mfx_v3/Kconfig.mfx"

endif
```

## drivers/mfx_v3/Kconfig.mfx
```kconfig
config MFXV2
    bool "MFXV2"
    default y
    depends on DT_HAS_MFX_ENABLED
    select I2C
    help
	  Enable this option to use the multi function expander driver.
```
